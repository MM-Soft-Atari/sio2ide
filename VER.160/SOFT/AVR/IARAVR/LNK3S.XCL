
-!                      - lnk3s.xcl -

    XLINK command file for the ICCA90 C-compiler using the -v1, -ms options.
    Segments are defined for a generic ATmega161 with a maximum of
     1 Kbytes data address space and   16 Kbytes program address space.

    Usage: xlink your_file(s) -f lnk1s

    File version:   $Revision: 1.13 $

    The following segments are used by the compiler:

    Program address space read only segments (internal Flash)
    =========================================================
    segment     address range  max size (dec)  used with compiler options
    -------     -------------  --------------  --------------------------
    INTVEC          0 -    1B   28 bytes       -e ("interrupt" keyword)
    RCODE          1C -  1FFF    8 Kbytes
    SWITCH         1C -  1FFF    8 Kbytes
    FLASH          1C -  1FFF    8 Kbytes      -e ("flash" keyword)
    CDATA0         1C -  1FFF    8 Kbytes      -e ("tiny" keyword)
    CDATA1         1C -  1FFF    8 Kbytes      (if -y then const objects)
    CCSTR          1C -  1FFF    8 Kbytes      -y
    CODE           1C -  1FFF    8 Kbytes

    Data address space read only segments (external PROM)
    =====================================================
    segment     address range  max size (dec)  used with compiler options
    -------     -------------  --------------  --------------------------
    CONST           ? -  FFFF   64 Kbytes      Not -y
    CSTR            ? -  FFFF   64 Kbytes      Not -y

    Data address space read/write segments
    ==============================================================
    segment     address range  max size (dec)  used with compiler options
    -------     -------------  --------------  --------------------------
    UDATA0         60 -    FF  224 bytes       -e ("tiny" keyword)
    IDATA0         60 -    FF  224 bytes       -e ("tiny" keyword)
    RSTACK         60 -  FFFF   64 Kbytes
    CSTACK         60 -  FFFF   64 Kbytes
    UDATA1         60 -  FFFF   64 Kbytes
    IDATA1         60 -  FFFF   64 Kbytes      (if -y then const objects)
    ECSTR          60 -  FFFF   64 Kbytes      -y

    Data address space read/write non-volatile segments (external EEPROM)
    =====================================================================
    segment     address range  max size (dec)  used with compiler options
    -------     -------------  --------------  --------------------------
    NO_INIT        60 -  FFFF   64 Kbytes      -e ("no_init" keyword)

   "tiny" pointers can only access objects in the range 0-FF.
    Option -y stores strings in ECSTR (init value in CCSTR) instead of CSTR,
    and stores constants in IDATA1 (init value in CDATA1).
-!

-!  First define CPU -!

-ca90

-! Program address space (in internal Flash memory) -!
-Z(CODE)INTVEC=0-53
-Z(CODE)RCODE,CONST,CCSTR,CSTR,FLASH,CDATA1,SWITCH,CODE=100-3FFF

-! Data address space (tiny data in internal SRAM) -!
-! The registers are in 0-1F and memmory mapped I/O in 20-5F -!
-! Return address stack (in internal SRAM) -!
-Z(DATA)UDATA0,CSTACK+60,RSTACK+30=60-FF

-Z(DATA)IDATA1,UDATA1,ECSTR=100-55F


